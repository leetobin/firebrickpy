## extraFiles/package/python-epydoc/Config.in
```kconfig
config BR2_PACKAGE_PYTHON_EPYDOC
	bool "python-epydoc"
	depends on BR2_PACKAGE_PYTHON
	help
	  python-epydoc package
```

## extraFiles/package/python-epydoc/Config.in.host
```kconfig
config BR2_PACKAGE_HOST_PYTHON_EPYDOC
	bool "host python-epydoc"
	depends on BR2_PACKAGE_PYTHON
	help
	  python-epydoc package
```

## extraFiles/package/python-ipaddr/Config.in
```kconfig
config BR2_PACKAGE_PYTHON_IPADDR
	bool "python-ipaddr"
	depends on BR2_PACKAGE_PYTHON
	help
	  python-ipaddr package
```

## extraFiles/package/python-ipaddr/Config.in.host
```kconfig
config BR2_PACKAGE_HOST_PYTHON_IPADDR
	bool "host python-ipaddr"
	depends on BR2_PACKAGE_PYTHON
	help
	  python-ipaddr package
```

## extraFiles/package/python-rtslib/Config.in
```kconfig
config BR2_PACKAGE_PYTHON_RTSLIB
	bool "python-rtslib"
	depends on BR2_PACKAGE_PYTHON
	depends on BR2_PACKAGE_PYTHON_IPADDR
	depends on BR2_PACKAGE_PYTHON_NETIFACES
	depends on BR2_PACKAGE_PYTHON_EPYDOC
	depends on BR2_PACKAGE_PYTHON_PYPARSING
	depends on BR2_PACKAGE_PYTHON_CONFIGOBJ
	help
	  RTSLib for LIO support
```
